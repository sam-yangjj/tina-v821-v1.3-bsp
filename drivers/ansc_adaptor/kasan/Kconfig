## drivers/ansc_adaptor/kasan/Kconfig
```kconfig
# SPDX-License-Identifier: GPL-2.0-only

config AW_ANSC_KASAN
    bool "tiny kasan for ansc"
    help
        ansc do not support kasan originally
```

## drivers/chips/Kconfig
```kconfig
# SPDX-License-Identifier: GPL-2.0-only

menu "Chip LeveL APIs"
depends on AW_BSP

config AW_CHIPS
	tristate "Chip LeveL APIs for Allwinner SoCs"
	depends on AW_BSP
	default n
	help
	  Provide chip level APIs for Allwinner SoCs.

choice
	prompt "Choose the Chip Version"
	depends on ARCH_SUN300IW1
	depends on AW_CHIPS
	default CHIP_V821
	help
	  Select the appropriate chip level API for Allwinner V821 SoCs.

config CHIP_V821
	bool "V821"
	help
	  Provide chip level APIs for Allwinner V821 SoCs.

config CHIP_V821B
	bool "V821B"
	help
	  Provide chip level APIs for Allwinner V821B SoCs.

endchoice

endmenu
```

## drivers/input/sensor/stk83xx/Kconfig
```kconfig
# SPDX-License-Identifier: GPL-2.0-only
	config SENSOR_STK83XX
	tristate "sensortek stk83xx accelerator driver"
	depends on I2C
	default n
	help
		If you say yes here, you get support for the stk83xx.
```

## drivers/misc/Kconfig
```kconfig
# SPDX-License-Identifier: GPL-2.0

menu "Misc Devices Drivers"

config SUNXI_DIRECT_GPIO
	tristate "Sunxi direct gpio support"
	help
	  This driver provides a set of interfaces for direct control of gpio,
	  including setting input/output, pull-up/pull-down, drive capability and
	  other interfaces (mainly used for control of box lights, buzzers, etc.)

source "$(BSP_TOP)drivers/misc/sunxi-rf/Kconfig"
source "$(BSP_TOP)drivers/misc/sunxi-addr/Kconfig"
source "$(BSP_TOP)drivers/misc/sunxi-bootevent/Kconfig"
source "$(BSP_TOP)drivers/misc/sunxi-tvutils/Kconfig"
source "$(BSP_TOP)drivers/misc/leds/Kconfig"
source "$(BSP_TOP)drivers/misc/sunxi-gpio-motor/Kconfig"
source "$(BSP_TOP)drivers/misc/sunxi-ircut/Kconfig"
source "$(BSP_TOP)drivers/misc/flash_app/Kconfig"
source "$(BSP_TOP)drivers/misc/aglink/Kconfig"
source "$(BSP_TOP)drivers/misc/aglink_gyro/Kconfig"
source "$(BSP_TOP)drivers/misc/sunxi-startup-info/Kconfig"
source "$(BSP_TOP)drivers/misc/sunxi-fastboot/Kconfig"

endmenu
```

## drivers/misc/aglink/Kconfig
```kconfig
# SPDX-License-Identifier: GPL-2.0-only
config AG_LINK
	tristate "ai glass link protocol"
	default n
	help
	  To compile this code as a module, choose M here.

if AG_LINK

config AGLINK_DEV_NUM
    int "Number of AGLINK devices"
    default 1
    range 1 3
    help
      Select the number of AGLINK devices. The default is 1, but
      you can change it to a value between 1 and 3.

config AG_LOOPBACK
	tristate "Support loopback device"
	depends on AG_LINK && MMC
	help
	  Enables support for the AGLINK connected via a loopback bus.  You will
	  need to add appropriate platform data glue in your board setup
	  file.

config AG_UART
	tristate "Support UART device"
	depends on AG_LINK && MMC
	help
	  Enables support for the AGLINK connected via a uart bus.  You will
	  need to add appropriate platform data glue in your board setup
	  file.

config AG_UART_KERNEL
	tristate "Support UART kernel device"
	depends on AG_LINK
	help
	  Enables support for the AGLINK connected via a uart(kernel) bus.  You will
	  need to add appropriate platform data glue in your board setup
	  file.

config AG_SAVE_THUMBNAIL
	tristate "Support save thumbnail"
	depends on AG_LINK && MMC
	help
	  Enables support for the AGLINK save thumbnail.  You will
	  need to add appropriate platform data glue in your board setup
	  file.

config AG_MODE_RTC_IDX
	int "ai glass mode stored at RTC X"
	depends on AG_LINK
	default 1

config AG_MODE_RTC_OFS
	int "ai glass mode RTC offset"
	depends on AG_LINK
	default 0

config AG_MODE_RTC_WIDTH
	int "ai glass mode RTC width"
	depends on AG_LINK
	default 4

config AG_UART_KERNEL_PORT
	string "kernel uart port "
	depends on AG_UART_KERNEL
	default "ttyS2"
	help
	  Configure the uart port used by the kernel(default:ttyS2).

config AG_UART_KERNEL_RATE
	int "kernel uart rate"
	depends on AG_UART_KERNEL
	default 150000
	help
	  Configure the uart rate used by the kernel(default:150000).

config AG_LED_CTRL
	tristate "via aglink ctrl led"
	depends on AG_LINK
	help
	  via aglink ctrl led.

config AG_AOV_CTRL
	tristate "via aglink ctrl aov"
	depends on AG_LINK
	help
	  via aglink ctrl aov.

config AG_USE_VAMLLOC_SAVE_PHOTO
	bool "take photo use vmalloc"
	depends on AG_LINK
	default n
	help
	  take photo use vmalloc.

config AG_USE_CHECKSUM
	bool "aglink do crc16 check"
	depends on AG_LINK
	default n
	help
	  aglink do crc16 check

endif
```

## drivers/misc/aglink_gyro/Kconfig
```kconfig
config AG_GYRO_USE
	tristate "via aglink gyros driver"
	depends on AG_LINK
	default 0
	help
	  via aglink gyros driver.
	choice
	    prompt "Gyro Sensor Choise"
		depends on AG_GYRO_USE
	    default GYRO_ICM42607

	config GYRO_ICM42607
	    bool "Sensor: ICM-42607"

	config GYRO_LSM6DSOX
	    bool "Sensor: LSM6DSOX"

	config GYRO_SC7U22
	    bool "Sensor: SC7U22"

	endchoice
```

## drivers/misc/flash_app/Kconfig
```kconfig
# SPDX-License-Identifier: GPL-2.0-only

menu "Flash App Drivers"
	depends on AW_BSP

config AW_FLASHAPP
	tristate "Flash app Support for Allwinner SoCs"
	depends on (AW_MTD || AW_MMC) && AW_BSP
	default n
	help
	  flash applications integrate storage differences and unify interfaces.

source "$(BSP_TOP)drivers/misc/flash_app/isp_param/Kconfig"
source "$(BSP_TOP)drivers/misc/flash_app/isp_iq_file/Kconfig"

endmenu
```

## drivers/misc/flash_app/isp_param/Kconfig
```kconfig
# SPDX-License-Identifier: GPL-2.0
#
# Allwinner isp-param driver.
#

config AW_ISP_PARAM
  tristate "Allwinner isp-param driver"
  depends on AW_FLASHAPP
  depends on VIN_INIT_MELIS
  help
    Allwinner isp-param driver
```

## drivers/misc/sunxi-fastboot/Kconfig
```kconfig
# SPDX-License-Identifier: GPL-2.0
#
# Allwinner fastboot services
#

menu "Fastboot Services"
	depends on AW_BSP

config AW_FASTBOOT_PANIC_DUMPER
  tristate "Fastboot panic dumper for dump kmsg when panic"
  depends on PRINTK
  help
    Allwinner fastboot panic dumper for dump kmsg when panic

endmenu
```

## drivers/misc/sunxi-ircut/Kconfig
```kconfig
# SPDX-License-Identifier: GPL-2.0
#
# Allwinner ir-cut driver.
#

config AW_IRCUT
  tristate "Allwinner ir-cut driver"
  depends on AW_PINCTRL
  help
    Allwinner ir-cut driver support for sun300iw1
```

## drivers/misc/sunxi-startup-info/Kconfig
```kconfig
# SPDX-License-Identifier: GPL-2.0
#
# Allwinner startup-info driver.
#

config AW_STARTUP_INFO
  tristate "Allwinner startup-info driver"
  depends on ARCH_SUN300IW1
  help
    Allwinner startup-info driver support for sun300iw1
```

## drivers/mtd/spi-nor-5.4/controllers/Kconfig
```kconfig
# SPDX-License-Identifier: GPL-2.0-only
config SPIF_SUNXI
	tristate "SUNXI SPIF Controller"
	depends on AW_BSP && OF
	help
	  Allwinner SOC SPIF controller, present on SUNXI chips.

config AW_SPIF_DELAYINIT
	bool "SUNXI SPIF Controller Delay Init"
	depends on SPIF_SUNXI && AW_RPMSG_NOTIFY
	default n
	help
	  If you need to use spif in the heterogeneous core first and then
	  notify spif in linux to obtain hardware resources, you can say yes
	  to this option, spif hardware resource init will be delayed.

config AW_SPIF_DELAYINIT_RPROC_NAME
	string "SUNXI SPIF Controller Delay Init Rproc Name"
	depends on AW_SPIF_DELAYINIT
	default "43030000.e907_rproc"
```

## drivers/net/wireless/v821_smac/Kconfig
```kconfig
config V821_SMAC_WLAN
	tristate "v821 linux mac WLAN support"
	default n
	select CFG80211
	select AVERAGE
	select CRYPTO
	select CRYPTO_ARC4
	help
	  To compile this code as a module, choose M here.


if V821_SMAC_WLAN

choice XRADIO_CHIP_V821_SMAC
	prompt "Xradio chip"
        help
		Specify the xradio chip.

config USE_V821_SIP_WIFI_T
	bool "enable v821 sip wifi"
	help
		if use v821 sip wifi, please select this.

config XR819_OR_XR819S_WLAN_T
	bool "enable xr819/xr819s wlan"
	help
		if don't use v821 sip wifi, please select this.

endchoice
endif

config XRADIO_DEBUG
	bool "enable xradio debug"
	depends on V821_SMAC_WLAN
	default y
	help
	    enable xradio debug

config XRADIO_DEBUG_MIN
	bool "enable xradio debug min"
	depends on V821_SMAC_WLAN
	default n
	help
	    enable xradio debug min

config XRADIO_ETF
	bool "enable xradio etf"
	depends on V821_SMAC_WLAN
	default y
	help
	    enable xradio etf

config XRADIO_DEBUGFS
	bool "enable xradio debugfs"
	depends on V821_SMAC_WLAN
	default y
	help
	    enable xradio debugfs

config XRADIO_DBG_FW_INF
	bool "enable xradio dbg fw inf"
	depends on V821_SMAC_WLAN
	default y
	help
	    enable xradio debug fw inf

config FW_TXRXBUF_USE_COEXIST_RAM
	bool "enable txrx buf use co-exist ram"
	depends on V821_SMAC_WLAN
	depends on CHIP_V821B
	default y
	help
	    enable xradio txrx buf use co-exist ram
```

## drivers/sound/pa/Kconfig
```kconfig
# SPDX-License-Identifier: GPL-2.0-or-later
#
# Allwinner audio pa driver Kconfig
#
# Copyright(c) 2022-2027 Allwinnertech Co., Ltd.

menu "PA drivers"

config SND_SOC_AW87XXX
	tristate "SoC Audio for awinic AW87XXX Smart K PA"
	depends on I2C
	help
	  This option enables support for AW87XXX Smart K PA.

endmenu
```

## drivers/touch_boost/Kconfig
```kconfig
# SPDX-License-Identifier: GPL-2.0-only
menu "Touch Boost Drivers"
	depends on AW_BSP

config AW_TOUCH_BOOST
       tristate "Allwinner touch boost Support"
       depends on AW_BSP && CPU_FREQ
       default n
       help
	 Support touch boost driver.If you need boost cpufreq when you
	 touch the touchscreen,say Yes to support this feature.

endmenu
```

## drivers/uart/sunxi-soft-uart/Kconfig
```kconfig
# SPDX-License-Identifier: GPL-2.0-or-later

config AW_SOFT_UART
	tristate "Enable Soft-Uart"
	depends on AW_BSP
	default n
	help
	  Enabled Soft-Uart(UART based on GPIO)
```

## drivers/video/sunxi/lcd_fb/Kconfig
```kconfig
# SPDX-License-Identifier: GPL-2.0-or-later
#
# SPI LCD Video configuration for sunxi platform
#

menu "SPI LCD Panel Drivers"
	depends on FB
	depends on AW_BSP

config LCD_FB
	tristate "LCD FB Driver Support (SPI LCD)"
	depends on (AW_SPI_NG || AW_SPI)
	select FB_CFB_FILLRECT
	select FB_CFB_COPYAREA
	select FB_CFB_IMAGEBLIT
	select FB_SYS_FOPS
	select BACKLIGHT_CLASS_DEVICE
	default n
	help
	  Framebuffer implementaion for LCD panel without DE and tcon

config AW_LCD_FB_USE_ION
	bool "LCD_FB use ION for framebuffer (Linux <= 5.4)"
	depends on LCD_FB
	depends on ION
	default n
	help
	  Enable linux framebuffer use ION (Linux <= 5.4) for LCD_FB

config AW_LCD_FB_USE_DMABUF
	bool "LCD_FB use DMABUF for framebuffer (Linux > 5.4)"
	depends on LCD_FB
	depends on DMABUF_HEAPS
	default n
	help
	  Enable linux framebuffer use DMABUF (Linux > 5.4) for LCD_FB

config LCD_FB_ENABLE_DEFERRED_IO
	bool "Enable LCD_FB FB_DEFERRED_IO"
	depends on LCD_FB
	depends on (!AW_LCD_FB_USE_ION && !AW_LCD_FB_USE_DMABUF)
	select FB_DEFERRED_IO
	default n
	help
	  Enable linux framebuffer FB_DEFERRED_IO for LCD_FB

config AW_LCD_FB_DECOMPRESS_LZMA
	bool "LCD_FB bootlogo with decompress LZMA logo"
	depends on LCD_FB
	select DECOMPRESS_LZMA
	default n
	help
	  Enable LCD_FB bootlogo with decompressed LZMA logo.
	  This option enables the LCD framebuffer (LCD_FB) to display the boot logo with an LZMA compressed image.
	  It requires the LCD_FB configuration option and also selects the DECOMPRESS_LZMA feature for handling LZMA compression.
	  When enabled, the kernel will decompress the boot logo from LZMA format before rendering it on the LCD screen.
	  This is useful for saving space in boot images, especially when working with systems where storage space is limited.
	  If unsure, it is safe to leave this option disabled.

menu "LCD FB Panels select"
	depends on LCD_FB
source "$(BSP_TOP)drivers/video/sunxi/lcd_fb/panels/Kconfig"
endmenu

endmenu
```
